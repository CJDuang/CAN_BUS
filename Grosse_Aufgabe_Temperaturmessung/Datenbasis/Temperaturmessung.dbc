VERSION ""

NS_ :

BS_:

BU_:
VAL_TABLE_ status_led 1 "AN" 0 "AUS" ;
VAL_TABLE_ taster_signal 1 "messung_starten" 0 "messung_stoppen" ;

BO_ 256 status_led: 8 Vector__XXX
 SG_ status_led_signal : 0|8@1+ (1,0) [0|255] "" Vector__XXX

BO_ 128 taster: 8 Vector__XXX
 SG_ taster_signal : 0|8@1+ (1,0) [0|255] "" Vector__XXX

BO_ 144 temperatur: 2 Vector__XXX
 SG_ temperatur_signal : 0|16@1+ (0.125,0) [0|8191.875] "" Vector__XXX

BA_DEF_  "BusType" STRING ;
BA_DEF_DEF_  "BusType" "CAN";
VAL_ 256 status_led_signal 1 "AN" 0 "AUS" ;
VAL_ 128 taster_signal 1 "messung_starten" 0 "messung_stoppen" ;
